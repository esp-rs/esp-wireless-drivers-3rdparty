## helper_project/sdkconfig.defaults
```kconfig
CONFIG_WPA_MBEDTLS_TLS_CLIENT=n
CONFIG_WPA_DPP_SUPPORT=n
CONFIG_WPA_MBEDTLS_CRYPTO=n
CONFIG_ESP32_WIFI_ENABLE_WPA3_OWE_STA=n
CONFIG_COMPILER_OPTIMIZATION_SIZE=y
CONFIG_MBEDTLS_SHA1_C=n
CONFIG_MBEDTLS_HARDWARE_SHA=n

CONFIG_ESP_WIFI_ENABLE_WPA3_SAE=n
CONFIG_ESP_WIFI_ENABLE_WPA3_OWE_STA=n
CONFIG_ESP_WIFI_MBEDTLS_TLS_CLIENT=n
CONFIG_ESP_WIFI_DPP_SUPPORT=n
CONFIG_ESP_WIFI_MBEDTLS_CRYPTO=n
CONFIG_COMPILER_OPTIMIZATION_SIZE=y

CONFIG_COMPILER_OPTIMIZATION_ASSERTIONS_SILENT=y
CONFIG_COMPILER_OPTIMIZATION_CHECKS_SILENT=y
CONFIG_APP_REPRODUCIBLE_BUILD=y
```

## patch/esp32h4/sdkconfig.defaults
```kconfig
CONFIG_BT_ENABLED=y
CONFIG_COMPILER_OPTIMIZATION_SIZE=y

CONFIG_COMPILER_OPTIMIZATION_ASSERTIONS_SILENT=y
CONFIG_COMPILER_OPTIMIZATION_CHECKS_SILENT=y
CONFIG_APP_REPRODUCIBLE_BUILD=y
```
